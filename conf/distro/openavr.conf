## conf/distro/openavr.conf
```bitbake
# Distro Layer configuration
#
# See https://embexus.com/2016/12/27/create-a-custom-linux-distribution-using-yocto/
#

include conf/distro/poky.conf

DISTRO = "openavr"
DISTRO_NAME = "OpenAVR-Linux"
DISTRO_VERSION = "1.0"
DISTRO_CODENAME = "Bokoblin"
SDK_VENDOR = "-openavr-sdk"
SDK_VERSION = "${DISTRO_VERSION}"
MAINTAINER = "troth@openavr.org"

TARGET_VENDOR = "-openavr"

#PACKAGE_CLASSES = "package_ipk"

# Use systemd as init manager
DISTRO_FEATURES_append = " systemd"
DISTRO_FEATURES_BACKFILL_CONSIDERED += "sysvinit"
VIRTUAL-RUNTIME_init_manager = "systemd"
VIRTUAL-RUNTIME_initscripts = "systemd-compat-units"

# Without this, the `wic` tool adds a broken entry to `/etc/fstab` which causes
# systemd to drop into rescue mode at boot time.
WIC_CREATE_EXTRA_ARGS_append = " --no-fstab-update"
```
